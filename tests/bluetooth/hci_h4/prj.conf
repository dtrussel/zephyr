## CMakeLists.txt
```
# SPDX-FileCopyrightText: Copyright The Zephyr Project Contributors
# SPDX-License-Identifier: Apache-2.0

cmake_minimum_required(VERSION 3.28.0)
find_package(Zephyr REQUIRED HINTS $ENV{ZEPHYR_BASE})
project(test_hci_h4)

# The H:4 driver is built without the Bluetooth subsystem (CONFIG_BT=n): the
# test provides the receive buffers and receives the packets itself. The
# options the driver and <zephyr/bluetooth/buf.h> need are set here.
target_sources(app PRIVATE
  src/main.c
  src/h4_harness.c
  ${ZEPHYR_BASE}/drivers/bluetooth/hci/h4.c
)
target_include_directories(app PRIVATE ${ZEPHYR_BASE}/subsys/bluetooth)
target_compile_definitions(app PRIVATE
  CONFIG_BT_HCI_DRIVER_LOG_LEVEL=LOG_LEVEL_WRN
  CONFIG_BT_DRV_RX_STACK_SIZE=2048
  CONFIG_BT_RX_PRIO=8
  CONFIG_BT_HCI_INIT_PRIORITY=50
  CONFIG_BT_BUF_ACL_RX_SIZE=251
  CONFIG_BT_BUF_EVT_RX_SIZE=68
  CONFIG_BT_BUF_EVT_RX_COUNT=4
  CONFIG_BT_BUF_ACL_TX_COUNT=3
)
```

## prj.conf
```kconfig
# SPDX-FileCopyrightText: Copyright The Zephyr Project Contributors
# SPDX-License-Identifier: Apache-2.0

CONFIG_ZTEST=y
CONFIG_SERIAL=y
CONFIG_UART_INTERRUPT_DRIVEN=y
CONFIG_IRQ_OFFLOAD=y
CONFIG_NET_BUF=y
CONFIG_NET_BUF_POOL_USAGE=y
CONFIG_LOG=y
CONFIG_LOG_MODE_IMMEDIATE=y
```

## app.overlay
```dts
/*
 * SPDX-FileCopyrightText: Copyright The Zephyr Project Contributors
 * SPDX-License-Identifier: Apache-2.0
 */

/ {
	chosen {
		zephyr,bt-hci = &h4_test_hci;
	};

	h4-test-uart {
		compatible = "vnd,h4-test-uart";
		status = "okay";

		h4_test_hci: bt_hci_uart {
			compatible = "zephyr,bt-hci-uart";
			status = "okay";
		};
	};
};
```

## dts/bindings/vnd,h4-test-uart.yaml
```yaml
# SPDX-FileCopyrightText: Copyright The Zephyr Project Contributors
# SPDX-License-Identifier: Apache-2.0

description: |
  Interrupt-driven UART of the H:4 driver test (tests/bluetooth/hci_h4):
  received bytes are injected by the test, and uart_irq_rx_ready() reports
  waiting bytes whether or not the RX interrupt is enabled.

compatible: "vnd,h4-test-uart"

include: uart-controller.yaml
```

## src/main.c
```c
/*
 * SPDX-FileCopyrightText: Copyright The Zephyr Project Contributors
 * SPDX-License-Identifier: Apache-2.0
 */

/*
 * Receive path of the H:4 driver (drivers/bluetooth/hci/h4.c). The script
 * of each case injects received bytes, and host transmissions, at driver
 * events (h4_harness.h), which places them deterministically inside the
 * windows where the driver's RX thread and its ISR interleave. The driver
 * allocates in its RX thread only after the ISR deferred the allocation,
 * so some windows the cases aim at do not open; their steps are optional
 * and run afterwards. Each case checks the delivered packets byte for byte,
 * that no buffer is overrun or leaked, that no RX interrupt is left pending
 * that the ISR ignores, that the RX thread allocated only after a deferral,
 * and that the whole script ran.
 */

#include <string.h>

#include <zephyr/bluetooth/buf.h>
#include <zephyr/bluetooth/hci_types.h>
#include <zephyr/kernel.h>
#include <zephyr/sys/byteorder.h>
#include <zephyr/sys/util.h>
#include <zephyr/ztest.h>

#include "h4_harness.h"

/* HCI_Command_Complete for HCI_Reset */
static const uint8_t evt_cc[] = {BT_HCI_H4_EVT, 0x0e, 0x04, 0x01, 0x03, 0x0c, 0x00};

/* ACL data packet on handle 1 with len payload bytes; returns its length */
static size_t make_acl(uint8_t *out, uint16_t len, uint8_t seed)
{
	out[0] = BT_HCI_H4_ACL;
	sys_put_le16(0x0001, &out[1]);
	sys_put_le16(len, &out[3]);
	for (uint16_t i = 0U; i < len; i++) {
		out[5 + i] = seed + i;
	}

	return 5U + len;
}

static void expect_delivered(uint32_t n)
{
	uint32_t got = h4_test_wait_delivered(n);

	zassert_equal(got, n, "%u packets delivered, %u expected", got, n);
}

static void expect_pkt(uint32_t idx, const uint8_t *data, size_t len)
{
	const struct h4_test_pkt *p = h4_test_pkt(idx);

	zassert_false(p->overrun, "packet %u: written past the buffer", idx);
	zassert_equal(p->len, len, "packet %u: %zu bytes delivered, %zu sent", idx, p->len, len);
	zassert_mem_equal(p->data, data, len, "packet %u: content differs", idx);
}

static void expect_clean(void)
{
	zassert_equal(h4_test_steps_left(), 0U, "script not run to its end");
	zassert_equal(h4_test_buffers_held(), 0U, "receive buffer leaked");
	zassert_false(h4_test_livelock(), "RX interrupt pending while the ISR reads nothing");
	zassert_true(h4_test_thread_allocs() <= h4_test_isr_alloc_failures(),
		     "RX thread allocated without a deferral (%u, %u ISR failures)",
		     h4_test_thread_allocs(), h4_test_isr_alloc_failures());
}

static void before(void *fixture)
{
	ARG_UNUSED(fixture);

	/* The cases share the buffer pools */
	zassume_equal(h4_test_buffers_held(), 0U, "buffer leaked by an earlier case");
}

static void after(void *fixture)
{
	ARG_UNUSED(fixture);

	h4_test_stop();
}

ZTEST_SUITE(hci_h4, NULL, NULL, before, after, NULL);

/* An event and ACL packets of different lengths, as a burst and byte by
 * byte.
 */
ZTEST(hci_h4, test_rx_baseline)
{
	static uint8_t burst[300];
	static uint8_t acl8[16];
	static uint8_t acl251[260];
	static uint8_t acl6[16];
	size_t n8 = make_acl(acl8, 8U, 0x10U);
	size_t n251 = make_acl(acl251, 251U, 0x20U);
	size_t n6 = make_acl(acl6, 6U, 0x30U);
	size_t n = 0U;

	memcpy(&burst[n], evt_cc, sizeof(evt_cc));
	n += sizeof(evt_cc);
	memcpy(&burst[n], acl8, n8);
	n += n8;
	memcpy(&burst[n], acl251, n251);
	n += n251;

	h4_test_start(NULL, 0U);
	h4_test_feed(burst, n);
	expect_delivered(3U);
	for (size_t i = 0U; i < n6; i++) {
		h4_test_feed(&acl6[i], 1U);
	}
	expect_delivered(4U);

	expect_pkt(0U, evt_cc, sizeof(evt_cc));
	expect_pkt(1U, acl8, n8);
	expect_pkt(2U, acl251, n251);
	expect_pkt(3U, acl6, n6);
	expect_clean();
}

/*
 * Stale wake-up: P2 completes while the RX thread delivers P1, so the
 * thread delivers P2 in the same pass and the semaphore stays given. The
 * header of P3 arrives after that pass; the thread wakes on the stale
 * semaphore with the RX interrupt enabled and allocates the buffer for P3
 * while the next byte of P3 arrives.
 */
ZTEST(hci_h4, test_rx_stale_wakeup)
{
	static uint8_t p1[16];
	static uint8_t p2[16];
	static uint8_t p3[32];
	size_t n1 = make_acl(p1, 8U, 0x10U);
	size_t n2 = make_acl(p2, 6U, 0x20U);
	size_t n3 = make_acl(p3, 20U, 0x30U);
	const struct h4_test_step steps[] = {
		{.ev = H4_TEST_EV_RX_ENABLE, .rx = p1, .rx_len = n1},
		{.ev = H4_TEST_EV_DELIVERED, .min_delivered = 1U, .rx = p2, .rx_len = n2},
		{.ev = H4_TEST_EV_RX_ENABLE,
		 .min_delivered = 2U,
		 .rx = p3,
		 .rx_len = 5U,
		 .optional = true},
		{.ev = H4_TEST_EV_ALLOC,
		 .min_delivered = 2U,
		 .rx = &p3[5],
		 .rx_len = 1U,
		 .optional = true},
		{.ev = H4_TEST_EV_RX_ENABLE,
		 .min_delivered = 2U,
		 .rx = &p3[6],
		 .rx_len = n3 - 6U,
		 .optional = true},
	};

	h4_test_start(steps, ARRAY_SIZE(steps));
	(void)h4_test_wait_delivered(2U);
	h4_test_finish_script();
	expect_delivered(3U);

	expect_pkt(0U, p1, n1);
	expect_pkt(1U, p2, n2);
	expect_pkt(2U, p3, n3);
	expect_clean();
}

/*
 * TX interrupt while the RX thread allocates: the header of P2 completes
 * while the thread delivers P1. The thread then allocates the buffer for
 * P2 with the RX interrupt disabled, and meanwhile the next byte of P2
 * arrives and the host sends a command.
 */
ZTEST(hci_h4, test_rx_tx_irq_during_alloc)
{
	static uint8_t p1[16];
	static uint8_t p2[32];
	size_t n1 = make_acl(p1, 8U, 0x10U);
	size_t n2 = make_acl(p2, 20U, 0x30U);
	const struct h4_test_step steps[] = {
		{.ev = H4_TEST_EV_RX_ENABLE, .rx = p1, .rx_len = n1},
		{.ev = H4_TEST_EV_DELIVERED, .min_delivered = 1U, .rx = p2, .rx_len = 5U},
		{.ev = H4_TEST_EV_ALLOC,
		 .min_delivered = 1U,
		 .rx = &p2[5],
		 .rx_len = 1U,
		 .send_tx = true,
		 .optional = true},
		{.ev = H4_TEST_EV_RX_ENABLE,
		 .min_delivered = 1U,
		 .rx = &p2[6],
		 .rx_len = n2 - 6U,
		 .optional = true},
	};

	h4_test_start(steps, ARRAY_SIZE(steps));
	(void)h4_test_wait_delivered(1U);
	h4_test_finish_script();
	expect_delivered(2U);

	expect_pkt(0U, p1, n1);
	expect_pkt(1U, p2, n2);
	zassert_equal(h4_test_tx_len(), H4_TEST_CMD_LEN, "command not sent");
	expect_clean();
}

/*
 * TX interrupt during the allocation that the ISR deferred to the RX
 * thread: no buffer is free when the header of P is complete. While the
 * thread waits, a buffer becomes free and the host sends a command.
 */
ZTEST(hci_h4, test_rx_tx_irq_during_deferred_alloc)
{
	static uint8_t p[32];
	size_t n = make_acl(p, 20U, 0x40U);
	const struct h4_test_step steps[] = {
		{.ev = H4_TEST_EV_RX_ENABLE, .rx = p, .rx_len = n},
		{.ev = H4_TEST_EV_ALLOC, .unblock = true, .send_tx = true},
	};

	h4_test_start(steps, ARRAY_SIZE(steps));
	h4_test_block_buffers(true);
	expect_delivered(1U);

	expect_pkt(0U, p, n);
	zassert_equal(h4_test_tx_len(), H4_TEST_CMD_LEN, "command not sent");
	expect_clean();
}

/*
 * Interrupts inside the hand-over: no buffer is free, so the ISR defers the
 * allocation for P. The RX thread allocates for P and hands the RX state
 * back; before it enables the RX interrupt the host sends a command, and
 * the ISR (TX interrupt) completes P, receives the header of E and defers
 * again. The enable then meets a deferred ISR while a buffer is free: the
 * ISR must leave E to the RX thread rather than allocate for it too.
 */
ZTEST(hci_h4, test_rx_redefer_in_handover)
{
	static uint8_t p[16];
	size_t n = make_acl(p, 1U, 0x50U);
	const struct h4_test_step steps[] = {
		{.ev = H4_TEST_EV_RX_ENABLE, .rx = p, .rx_len = n, .block = true},
		{.ev = H4_TEST_EV_ALLOC, .unblock = true},
		{.ev = H4_TEST_EV_RX_ENABLE_PRE,
		 .rx = evt_cc,
		 .rx_len = sizeof(evt_cc),
		 .block = true,
		 .send_tx = true},
		{.ev = H4_TEST_EV_RX_ENABLE, .unblock = true},
		{.ev = H4_TEST_EV_ALLOC, .min_delivered = 1U, .optional = true},
	};

	h4_test_start(steps, ARRAY_SIZE(steps));
	(void)h4_test_wait_delivered(2U);
	h4_test_finish_script();
	expect_delivered(2U);

	expect_pkt(0U, p, n);
	expect_pkt(1U, evt_cc, sizeof(evt_cc));
	zassert_equal(h4_test_tx_len(), H4_TEST_CMD_LEN, "command not sent");
	expect_clean();
}

/*
 * Buffer size on the RX thread's allocation path: an ACL packet that fits
 * the buffer only without its header is discarded, and the next packet is
 * received intact.
 */
ZTEST(hci_h4, test_rx_size_check_with_header)
{
	static uint8_t rx[300];
	static uint8_t next[16];
	/* Payload length that fits the tailroom, but not with the header */
	size_t n_big = make_acl(rx, BT_BUF_ACL_RX_SIZE - 1U - 2U, 0x60U);
	size_t n_next = make_acl(next, 8U, 0x70U);
	const struct h4_test_step steps[] = {
		{.ev = H4_TEST_EV_RX_ENABLE, .rx = rx, .rx_len = n_big + n_next},
		{.ev = H4_TEST_EV_ALLOC, .unblock = true},
	};

	memcpy(&rx[n_big], next, n_next);
	h4_test_start(steps, ARRAY_SIZE(steps));
	h4_test_block_buffers(true);
	expect_delivered(1U);

	expect_pkt(0U, next, n_next);
	expect_clean();
}
```

## src/h4_harness.c
```c
/*
 * SPDX-FileCopyrightText: Copyright The Zephyr Project Contributors
 * SPDX-License-Identifier: Apache-2.0
 */

#define DT_DRV_COMPAT vnd_h4_test_uart

#include <string.h>

#include <zephyr/bluetooth/buf.h>
#include <zephyr/bluetooth/hci_types.h>
#include <zephyr/device.h>
#include <zephyr/drivers/bluetooth.h>
#include <zephyr/drivers/uart.h>
#include <zephyr/irq_offload.h>
#include <zephyr/kernel.h>
#include <zephyr/net_buf.h>
#include <zephyr/sys/util.h>
#include <zephyr/ztest.h>

#include "h4_harness.h"

#define ACL_BUFS      4U
#define EVT_BUFS      4U
#define GUARD_LEN     16U
#define GUARD_BYTE    0xa5U
#define RX_QUEUE_LEN  1024U
#define TX_SINK_LEN   64U
/* uart_irq_is_pending() calls with only RX pending and no byte read */
#define LIVELOCK_POLL 1000U

/* Each buffer has a guard behind its nominal size that shows an overrun */
NET_BUF_POOL_FIXED_DEFINE(acl_pool, ACL_BUFS, BT_BUF_ACL_RX_SIZE + GUARD_LEN, 0, NULL);
NET_BUF_POOL_FIXED_DEFINE(evt_pool, EVT_BUFS, BT_BUF_EVT_RX_SIZE + GUARD_LEN, 0, NULL);
NET_BUF_POOL_FIXED_DEFINE(tx_pool, 1, BT_BUF_CMD_SIZE(8), 0, NULL);

static const struct device *const h4_dev = DEVICE_DT_GET(DT_CHOSEN(zephyr_bt_hci));

/* HCI_Set_Event_Mask */
static const uint8_t tx_cmd[H4_TEST_CMD_LEN] = {
	BT_HCI_H4_CMD, 0x01, 0x0c, 0x08, 0xff, 0xff, 0xff, 0xff, 0xff, 0xff, 0xff, 0x3f,
};

static struct {
	/* Test UART */
	const struct device *uart;
	uart_irq_callback_user_data_t cb;
	void *cb_data;
	bool rx_enabled;
	bool tx_enabled;
	uint8_t rxq[RX_QUEUE_LEN];
	size_t rx_head;
	size_t rx_tail;
	uint32_t rx_reads;
	uint32_t rx_reads_seen;
	uint32_t stall;
	bool livelock;
	size_t tx_len;

	/* Script */
	const struct h4_test_step *steps;
	size_t n_steps;
	size_t step;

	/* Receive buffers */
	bool blocked;
	struct k_sem unblock;
	uint32_t thread_allocs;
	uint32_t isr_alloc_failures;

	/* Delivered packets */
	uint32_t delivered;
	struct k_sem delivered_sem;
	struct h4_test_pkt pkts[H4_TEST_MAX_PKTS];
} h;

static size_t rx_avail(void)
{
	return h.rx_tail - h.rx_head;
}

static bool irq_pending(void)
{
	bool rx = h.rx_enabled && rx_avail() > 0U;

	if (rx && !h.tx_enabled && h.rx_reads == h.rx_reads_seen) {
		/* Report the livelock and let the ISR return */
		if (++h.stall > LIVELOCK_POLL) {
			h.livelock = true;
			return false;
		}
	} else {
		h.stall = 0U;
	}
	h.rx_reads_seen = h.rx_reads;

	return rx || h.tx_enabled;
}

static void uart_isr(const void *param)
{
	ARG_UNUSED(param);

	h.cb(h.uart, h.cb_data);
}

/* Raise the interrupt if its condition holds. In the ISR, the driver's
 * loop checks uart_irq_is_pending() itself.
 */
static void fire(void)
{
	if (k_is_in_isr() || h.cb == NULL) {
		return;
	}

	h.stall = 0U;
	if (irq_pending()) {
		irq_offload(uart_isr, NULL);
	}
}

static void rx_put(const uint8_t *data, size_t len)
{
	zassert_true(h.rx_tail + len <= RX_QUEUE_LEN);
	memcpy(&h.rxq[h.rx_tail], data, len);
	h.rx_tail += len;
}

static void send_cmd(void)
{
	struct net_buf *buf = net_buf_alloc(&tx_pool, K_NO_WAIT);

	zassert_not_null(buf);
	net_buf_add_mem(buf, tx_cmd, sizeof(tx_cmd));
	zassert_ok(bt_hci_send(h4_dev, buf));
}

static void run_step(const struct h4_test_step *s)
{
	h.step++;
	if (s->block) {
		h.blocked = true;
	}
	if (s->unblock) {
		h.blocked = false;
		k_sem_give(&h.unblock);
	}
	if (s->rx_len > 0U) {
		rx_put(s->rx, s->rx_len);
	}
	if (s->send_tx) {
		send_cmd();
	}
	fire();
}

static void script_event(enum h4_test_event ev)
{
	const struct h4_test_step *s;

	if (k_is_in_isr() || h.step >= h.n_steps) {
		return;
	}

	s = &h.steps[h.step];
	if (s->ev != ev || h.delivered < s->min_delivered) {
		return;
	}

	run_step(s);
}

static int test_fifo_fill(const struct device *dev, const uint8_t *data, int len)
{
	ARG_UNUSED(dev);
	ARG_UNUSED(data);

	if (len <= 0) {
		return 0;
	}

	h.tx_len++;

	return 1;
}

static int test_fifo_read(const struct device *dev, uint8_t *data, const int size)
{
	ARG_UNUSED(dev);

	if (size <= 0 || rx_avail() == 0U) {
		return 0;
	}

	data[0] = h.rxq[h.rx_head++];
	h.rx_reads++;

	return 1;
}

static void test_irq_tx_enable(const struct device *dev)
{
	ARG_UNUSED(dev);

	h.tx_enabled = true;
	fire();
}

static void test_irq_tx_disable(const struct device *dev)
{
	ARG_UNUSED(dev);

	h.tx_enabled = false;
}

static int test_irq_tx_ready(const struct device *dev)
{
	ARG_UNUSED(dev);

	return h.tx_enabled ? 1 : 0;
}

static void test_irq_rx_enable(const struct device *dev)
{
	ARG_UNUSED(dev);

	script_event(H4_TEST_EV_RX_ENABLE_PRE);
	h.rx_enabled = true;
	script_event(H4_TEST_EV_RX_ENABLE);
	fire();
}

static void test_irq_rx_disable(const struct device *dev)
{
	ARG_UNUSED(dev);

	h.rx_enabled = false;
}

static int test_irq_rx_ready(const struct device *dev)
{
	ARG_UNUSED(dev);

	return rx_avail() > 0U ? 1 : 0;
}

static int test_irq_is_pending(const struct device *dev)
{
	ARG_UNUSED(dev);

	return irq_pending() ? 1 : 0;
}

static void test_irq_update(const struct device *dev)
{
	ARG_UNUSED(dev);
}

static void test_irq_callback_set(const struct device *dev, uart_irq_callback_user_data_t cb,
				  void *user_data)
{
	h.uart = dev;
	h.cb = cb;
	h.cb_data = user_data;
}

static DEVICE_API(uart, test_uart_api) = {
	.fifo_fill = test_fifo_fill,
	.fifo_read = test_fifo_read,
	.irq_tx_enable = test_irq_tx_enable,
	.irq_tx_disable = test_irq_tx_disable,
	.irq_tx_ready = test_irq_tx_ready,
	.irq_rx_enable = test_irq_rx_enable,
	.irq_rx_disable = test_irq_rx_disable,
	.irq_rx_ready = test_irq_rx_ready,
	.irq_is_pending = test_irq_is_pending,
	.irq_update = test_irq_update,
	.irq_callback_set = test_irq_callback_set,
};

DEVICE_DT_INST_DEFINE(0, NULL, NULL, NULL, NULL, PRE_KERNEL_1, 0, &test_uart_api);

/* Receive buffers as the Bluetooth host provides them: the H:4 packet type
 * first, nominal size of the host's pools.
 */
static struct net_buf *alloc_rx(struct net_buf_pool *pool, uint16_t size, uint8_t h4_type,
				k_timeout_t timeout)
{
	struct net_buf *buf;

	if (K_TIMEOUT_EQ(timeout, K_FOREVER)) {
		h.thread_allocs++;
		script_event(H4_TEST_EV_ALLOC);
	}

	if (h.blocked) {
		if (K_TIMEOUT_EQ(timeout, K_NO_WAIT)) {
			h.isr_alloc_failures++;
			return NULL;
		}
		(void)k_sem_take(&h.unblock, timeout);
	}

	buf = net_buf_alloc(pool, timeout);
	if (buf != NULL) {
		buf->size = size;
		memset(buf->__buf + size, GUARD_BYTE, GUARD_LEN);
		net_buf_add_u8(buf, h4_type);
	} else if (K_TIMEOUT_EQ(timeout, K_NO_WAIT)) {
		h.isr_alloc_failures++;
	}

	return buf;
}

struct net_buf *bt_buf_get_rx(enum bt_buf_type type, k_timeout_t timeout)
{
	if (type == BT_BUF_EVT) {
		return alloc_rx(&evt_pool, BT_BUF_EVT_RX_SIZE, BT_HCI_H4_EVT, timeout);
	}

	return alloc_rx(&acl_pool, BT_BUF_ACL_RX_SIZE, BT_HCI_H4_ACL, timeout);
}

struct net_buf *bt_buf_get_evt(uint8_t evt, bool discardable, k_timeout_t timeout)
{
	ARG_UNUSED(evt);
	ARG_UNUSED(discardable);

	return bt_buf_get_rx(BT_BUF_EVT, timeout);
}

/* Used by the driver's debug logging */
const char *bt_hex(const void *buf, size_t len)
{
	ARG_UNUSED(buf);
	ARG_UNUSED(len);

	return "";
}

static bool overrun(const struct net_buf *buf)
{
	if (buf->len > buf->size) {
		return true;
	}

	for (size_t i = 0U; i < GUARD_LEN; i++) {
		if (buf->__buf[buf->size + i] != GUARD_BYTE) {
			return true;
		}
	}

	return false;
}

static int recv(const struct device *dev, struct net_buf *buf)
{
	ARG_UNUSED(dev);

	if (h.delivered < H4_TEST_MAX_PKTS) {
		struct h4_test_pkt *p = &h.pkts[h.delivered];

		p->len = MIN(buf->len, sizeof(p->data));
		memcpy(p->data, buf->data, p->len);
		p->overrun = overrun(buf);
	}

	net_buf_unref(buf);
	h.delivered++;
	k_sem_give(&h.delivered_sem);
	script_event(H4_TEST_EV_DELIVERED);

	return 0;
}

void h4_test_start(const struct h4_test_step *steps, size_t n_steps)
{
	const struct device *uart = h.uart;
	uart_irq_callback_user_data_t cb = h.cb;
	void *cb_data = h.cb_data;

	memset(&h, 0, sizeof(h));
	h.uart = uart;
	h.cb = cb;
	h.cb_data = cb_data;
	h.steps = steps;
	h.n_steps = n_steps;
	k_sem_init(&h.unblock, 0, 1);
	k_sem_init(&h.delivered_sem, 0, K_SEM_MAX_LIMIT);

	zassert_ok(bt_hci_open(h4_dev, recv));
}

void h4_test_stop(void)
{
	(void)bt_hci_close(h4_dev);
}

void h4_test_feed(const uint8_t *data, size_t len)
{
	rx_put(data, len);
	fire();
}

void h4_test_block_buffers(bool blocked)
{
	h.blocked = blocked;
}

uint32_t h4_test_wait_delivered(uint32_t n)
{
	int64_t end = k_uptime_get() + 500;

	while (h.delivered < n && k_uptime_get() < end) {
		(void)k_sem_take(&h.delivered_sem, K_MSEC(10));
	}
	k_msleep(20);

	return h.delivered;
}

const struct h4_test_pkt *h4_test_pkt(uint32_t idx)
{
	return &h.pkts[idx];
}

void h4_test_finish_script(void)
{
	k_msleep(20);
	while (h.step < h.n_steps && h.steps[h.step].optional) {
		run_step(&h.steps[h.step]);
		k_msleep(20);
	}
}

size_t h4_test_steps_left(void)
{
	return h.n_steps - h.step;
}

uint32_t h4_test_buffers_held(void)
{
	return (acl_pool.buf_count - atomic_get(&acl_pool.avail_count)) +
	       (evt_pool.buf_count - atomic_get(&evt_pool.avail_count));
}

size_t h4_test_tx_len(void)
{
	return h.tx_len;
}

bool h4_test_livelock(void)
{
	return h.livelock;
}

uint32_t h4_test_thread_allocs(void)
{
	return h.thread_allocs;
}

uint32_t h4_test_isr_alloc_failures(void)
{
	return h.isr_alloc_failures;
}
```

## src/h4_harness.h
```c
/*
 * SPDX-FileCopyrightText: Copyright The Zephyr Project Contributors
 * SPDX-License-Identifier: Apache-2.0
 */

/*
 * Harness of the H:4 driver test: a test UART, the receive buffers, the
 * receive callback, and a script of received bytes injected at driver
 * events.
 *
 * Test UART (vnd,h4-test-uart), with the interrupt semantics of the STM32
 * driver:
 * - uart_irq_rx_ready() reports waiting bytes whether or not the RX
 *   interrupt is enabled; uart_irq_is_pending() is true for RX enabled
 *   with bytes waiting, or for TX enabled; uart_irq_tx_ready() is true
 *   while TX is enabled.
 * - uart_fifo_read() and uart_fifo_fill() move at most one byte per call,
 *   so a command sent runs the ISR once per byte.
 * - The interrupt is raised (irq_offload) as soon as its condition holds.
 *   With interrupts locked it stays pending until they are unlocked, as
 *   a hardware interrupt does. This holds for irq_offload() on native_sim
 *   only, so the test runs there.
 *
 * A script step runs at the first occurrence of its event once at least
 * min_delivered packets were delivered; steps run in order, one per event.
 * Events occur in thread context only:
 * - H4_TEST_EV_RX_ENABLE_PRE: in uart_irq_rx_enable(), before the RX
 *   interrupt is enabled;
 * - H4_TEST_EV_RX_ENABLE: in uart_irq_rx_enable(), after it is enabled;
 * - H4_TEST_EV_ALLOC: in a K_FOREVER receive buffer allocation (the
 *   driver's RX thread);
 * - H4_TEST_EV_DELIVERED: in the receive callback, once the packet is
 *   recorded.
 * An optional step aims at a window that a fixed driver no longer opens;
 * h4_test_finish_script() then runs it from the test thread.
 */

#ifndef H4_HARNESS_H_
#define H4_HARNESS_H_

#include <stdbool.h>
#include <stddef.h>
#include <stdint.h>

#define H4_TEST_MAX_PKTS    8U
#define H4_TEST_MAX_PKT_LEN 300U
/* Length of the HCI command the script sends */
#define H4_TEST_CMD_LEN     12U

enum h4_test_event {
	H4_TEST_EV_RX_ENABLE_PRE,
	H4_TEST_EV_RX_ENABLE,
	H4_TEST_EV_ALLOC,
	H4_TEST_EV_DELIVERED,
};

struct h4_test_step {
	enum h4_test_event ev;
	uint32_t min_delivered;
	/* Bytes that arrive at the UART */
	const uint8_t *rx;
	size_t rx_len;
	/* Make buffer allocation fail (K_NO_WAIT) or wait (K_FOREVER), or
	 * end that, before the bytes arrive.
	 */
	bool block;
	bool unblock;
	/* Send an HCI command, which raises the TX interrupt */
	bool send_tx;
	/* Run by h4_test_finish_script() if its event does not occur */
	bool optional;
};

struct h4_test_pkt {
	size_t len;
	uint8_t data[H4_TEST_MAX_PKT_LEN];
	/* Written past the end of the buffer */
	bool overrun;
};

/* Reset the harness, set the script and open the driver */
void h4_test_start(const struct h4_test_step *steps, size_t n_steps);
/* Close the driver */
void h4_test_stop(void);
/* Bytes arrive at the UART */
void h4_test_feed(const uint8_t *data, size_t len);
/* As the block and unblock script steps. Right after h4_test_start() it
 * takes effect before the driver receives anything.
 */
void h4_test_block_buffers(bool blocked);

/* Wait until n packets are delivered or a timeout expires, then a little
 * longer so a surplus delivery shows too. Returns the packets delivered.
 */
uint32_t h4_test_wait_delivered(uint32_t n);
const struct h4_test_pkt *h4_test_pkt(uint32_t idx);

/* Let the driver settle, then run the optional steps left, in order and
 * regardless of min_delivered; stops at a required step.
 */
void h4_test_finish_script(void);
size_t h4_test_steps_left(void);
/* Receive buffers not returned to their pools */
uint32_t h4_test_buffers_held(void);
/* Bytes the driver sent */
size_t h4_test_tx_len(void);
/* An RX interrupt was pending while the ISR read nothing: on hardware the
 * ISR would never return.
 */
bool h4_test_livelock(void);
/* Receive buffer allocations with K_FOREVER (the driver's RX thread), and
 * those with K_NO_WAIT that failed (the ISR)
 */
uint32_t h4_test_thread_allocs(void);
uint32_t h4_test_isr_alloc_failures(void);

#endif /* H4_HARNESS_H_ */
```
